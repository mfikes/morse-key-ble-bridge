## west.yml
```yaml
manifest:
  remotes:
    - name: ncs
      url-base: https://github.com/nrfconnect
    - name: zephyrproject
      url-base: https://github.com/zephyrproject-rtos


  # Please add items below based on alphabetical order.
  # These dependencies may need updating if new features are added to the firmware.
  projects:
    # For some weird reason, sdk-nrf needs to be first
    - name: sdk-nrf
      path: nrf
      remote: ncs
      revision: v2.6.0
      import: true

  self:
    path: application
```
